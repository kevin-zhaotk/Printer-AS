## app/src/main/res/raw/extgpio/Kconfig
```kconfig
config EXT_GPIO
	tristate "external gpio for printer"
	default n
	help
		this is FPGA gpio driver for printer project
```

## app/src/main/res/raw/fpga/Kconfig
```kconfig
config FPGA_SUNXI_GPIO
	tristate "FPGA gpio sunxi"
	default n
	help
		this is FPGA gpio driver for printer project
```
